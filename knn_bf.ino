#include <WiFi.h>
#include <Adafruit_MPU6050.h>
#include <Wire.h>
#include <BleKeyboard.h>

float points[][16] = {{9.67, 0.07, -2.57, 9.67, 0.14, -2.84, 9.68, 0.24, -2.95, 9.75, 0.17, -2.68, 9.62, 0.34, -3.06, 2.0},
{8.71, 5.32, -4.79, 9.82, -0.81, -4.79, 7.76, -2.11, 0.61, 9.22, -9.74, -2.01, 5.61, 0.11, -5.49, 3.0},
{9.58, -0.81, -2.49, 9.76, -0.85, -2.54, 9.52, -1.38, -2.90, 9.78, -1.56, -2.56, 9.68, -0.50, -2.21, 2.0},
{8.13, -0.03, 0.03, 5.88, -6.47, 1.01, 9.10, -4.78, -0.42, 5.79, -8.20, -0.32, 5.47, -2.43, 0.20, 0.0},
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{9.98, 0.21, -1.06, 12.06, -2.98, 0.85, 5.42, -2.06, 1.02, 7.92, -5.51, -1.87, 8.45, -4.54, 0.16, 0.0}};

// WiFiの設定
const char* ssid = "sikakamonanoka";
const char* password = "kamosikadayo";

// ArduinoのIPアドレスを指定する
IPAddress ip(192, 168, 0, 179);  // 任意のIPアドレスにゃ
IPAddress gateway(192, 168, 0, 1);  // ゲートウェイのIPアドレスにゃ
IPAddress subnet(255, 255, 255, 0);  // サブネットマスクのIPアドレスにゃ
IPAddress dns(8, 8, 8, 8);  // DNSサーバのIPアドレスにゃ

// サーバのIPアドレスとポート番号
IPAddress serverIP(192, 168, 0, 13);  // Python側のIPアドレスにゃ
unsigned int serverPort = 17900;  // Python側と同じポート番号にゃ

const int windowSize = 5; // 前後何個分のデータをまとめるか
const int kLen = 3; //いくつ近傍を見るか
float accs[windowSize * 3] = {}; // 加速度データを入れる3次元のものが5個入る二次元配列？[[15個あるよ],[]]っていう風な
float accsDif[windowSize * 3] = {}; // 加速度データの各次元の差分を保存しておく
int count; //ループ回数カウント用

WiFiClient client;

Adafruit_MPU6050 mpu;

BleKeyboard bleKeyboard("footGenshin", "kamosika", 100);

int lastIndex = 0; //最新の分類結果

void setup() {
  // カウントリセット
  count = 0;
  // シリアル通信を開始する
  Serial.begin(9600);

  // I2C設定
  Wire.begin(6,7);

  // MPU6050設定
  mpu = Adafruit_MPU6050();
  mpu.begin();

  // キーボード起動
  bleKeyboard.begin();

  // WiFiに接続する
  WiFi.begin(ssid, password);
  while (WiFi.status() != WL_CONNECTED) {
    delay(1000);
    Serial.println("Connecting to WiFi...");
  }
  Serial.println("Connected to WiFi");

  //クライアントとサーバを接続する
  if (!client.connect(serverIP, serverPort)) {
    Serial.println("Connection failed");
    return;
  }
  Serial.println("Connected to server");

  Serial.print("加速度");
}

void loop() {
  
  sensors_event_t a, g, temp;
  mpu.getEvent(&a, &g, &temp);
  float x_acc = a.acceleration.x;
  float y_acc = a.acceleration.y;
  float z_acc = a.acceleration.z;

  
  // Serial.println(x_acc);
  // Serial.println(y_acc);
  // Serial.println(z_acc);

  // 配列に加速度を追加
  accs[0+count*3] = x_acc;
  accs[1+count*3] = y_acc;
  accs[2+count*3] = z_acc;

  // Serial.println("accsの値生");
  // Serial.println(accs[2+count*3]); //これが同じ値になり続けているのがおかしいと思う

  // データの送信間隔を設定する
  delay(100);

  count = count + 1;

  // windowサイズ分のデータを集めた後の処理
  float distance = 0.0;
  float min_distance[kLen] = {};
  float category_value[kLen] = {};
  if(count > 4){
    count = 0;
    // 各点の距離を求める
    distance = 0.0;
  
    // 配列の各要素を10000で初期化する
    for (int i = 0; i < kLen; i++) {
      min_distance[i] = 1000000.0;
      category_value[i] = 10000.0;
    }
    int numRows = sizeof(points) / sizeof(points[0]); // 行数
    // Serial.println("行数を見たい");
    // Serial.println(numRows);
    for (int i = 0; i < numRows - 1; i++) {
      for ( int n = 0; n < windowSize * 3; n++){
        distance += pow(accs[n] - points[i][n], 2);

        // Serial.println("accsの値");
        // Serial.println(accs[n]); //これが同じ値になり続けているのがおかしいと思う
        // Serial.println("pointsの値");
        // Serial.println(points[i][n]);
        // Serial.println("distanceの値");
        // Serial.println(distance);
        // Serial.println("nの値");
        // Serial.println(n);
        // delay(100);
      }
      distance = sqrt(distance);

      // Serial.println("距離の計算をする");
      // Serial.println(distance); //これが同じ値になり続けているのがおかしいと思う
      // delay(500);

      // 距離が小さいなら結果を保存する
      for (int d = 0; d < kLen; d++){
        if (min_distance[d] > distance){
          float tmp = min_distance[d];
          float tmp_category = category_value[d];

          min_distance[d] = distance;
          category_value[d] = points[i][kLen * windowSize];
          for (int j = d; j < kLen - 1; j++){
            //わけわからん、もう
            float nextTmp = min_distance[j + 1];
            float nextTmpCategory = category_value[j + 1];
            min_distance[j + 1] = tmp;
            category_value[j + 1] = tmp_category;
            
            tmp = nextTmp;
            tmp_category = nextTmpCategory;
          }
          break;
        }

      // Serial.println("---jfjfjf----");
      // for (int d = 0; d < kLen; d++){ 
      //   Serial.println(min_distance[d]);
      // }
      // Serial.println("---jfjfjf----");

      }
      distance = 0.0; //distanceのリセットを忘れていた（#^ω^）ﾋﾟｷﾋﾟｷ
    }

    Serial.println("結果出たよ！");
    Serial.println("----；；---");
    for (int d = 0; d < kLen; d++){
      Serial.print(min_distance[d]);
    }
    Serial.println("");
    for (int d = 0; d < kLen; d++){
      Serial.print(category_value[d]);
    }
    Serial.println("");
    Serial.println("----；；---");
    // 対応表{'jump': 0.0, 'run': 1.0, 'stand': 2.0, 'walk': 3.0}

    // 各数字の出現回数をカウントする変数を初期化
    int count[4] = {0}; // 0.0, 1.0, 2.0, 3.0 の順でカウントする

    // 配列を走査して数字の出現回数をカウント
    for (int i = 0; i < kLen; i++) {
        // 数字が0.0, 1.0, 2.0, 3.0のいずれかであれば、該当するカウンタをインクリメント
        if (category_value[i] == 0.0) {
            count[0]++;
        } else if (category_value[i] == 1.0) {
            count[1]++;
        } else if (category_value[i] == 2.0) {
            count[2]++;
        } else if (category_value[i] == 3.0) {
            count[3]++;
        }
    }

    // 最も多く現れた数字を探す
    int maxCountIndex = 0;
    for (int i = 1; i < 4; i++) {
        if (count[i] > count[maxCountIndex]) {
            maxCountIndex = i;
        }
    }
    
    client.print(maxCountIndex);

    if (lastIndex != maxCountIndex){
      lastIndex = maxCountIndex;
      bleKeyboard.releaseAll();
      // キー入力を行う
      if (lastIndex == 0){
        bleKeyboard.write(' '); //ジャンプ
      } else if(lastIndex == 1){
        bleKeyboard.press('w'); //走るだけど仮で歩くにしておく
      } else if(lastIndex == 2){
        bleKeyboard.releaseAll(); //何もしない。棒立ち
      } else if(lastIndex == 3){
        bleKeyboard.press('w'); //歩く
      }
      
    }
    
  }

  

  // 加速度を送る(X,Y,Z)
  //client.print(String(a.acceleration.x)+","+String(a.acceleration.y)+","+String(a.acceleration.z));
 
  
}

